## main/Kconfig.projbuild
```kconfig
menu "Lab Equipment Manager"

menu "Server Configuration"
config SERVER_URL
    string "Server URL"
    default "example.com"

choice TRANSFER_PROTOCOL
    prompt "Transfer Protocol"
    default TRANSFER_PROTOCOL_HTTPS

config TRANSFER_PROTOCOL_HTTP
    bool "http"
config TRANSFER_PROTOCOL_HTTPS
    bool "https"
endchoice

config VERIFY_SERVER_CERT
    bool "Verify Server SSL Certificate"
    default "y"
    depends on TRANSFER_PROTOCOL_HTTPS
endmenu

menu "WiFi Configuration"
config WIFI_SSID
    string "WiFi SSID"
    default "myssid"

config WIFI_PASSWORD
    string "WiFi Password"
    default "mypassword"

config WIFI_HOSTNAME_PREFIX
    string "WiFi Hostname Prefix"
    default "LEM"
endmenu

menu "NTP Configuration"
config NTP_SERVER_URL
    string "NTP Server URL"
    default "pool.ntp.org"

config NTP_TIMEZONE
    string "NTP Timezone"
    default "CST-8"
endmenu

menu "GUI Configuration"
choice LCD_ORIENTATION
    prompt "LCD Orientation"
    default LCD_ORIENTATION_NORMAL

config LCD_ORIENTATION_NORMAL
    bool "Normal"
config LCD_ORIENTATION_UPSIDE_DOWN
    bool "Upside Down"
endchoice

config LCD_ROTATION_DEGREE
    int
    default  90 if LCD_ORIENTATION_NORMAL
    default 270 if LCD_ORIENTATION_UPSIDE_DOWN

config LCD_RST_PIN
    int "LCD RST Pin"
    default 14

config LCD_DC_PIN
    int "LCD DC Pin"
    default 23

config LCD_BL_PIN
    int "LCD BL Pin"
    default 4

config SPI_SCLK_PIN
    int "SPI SCLK Pin"
    default 5

config SPI_MOSI_PIN
    int "SPI MOSI Pin"
    default 18

config SPI_CS_PIN
    int "SPI CS Pin"
    default 27
endmenu

menu "LED Configuration"
config ENABLE_LED
    bool "Enable LED"
    default y

choice LED_ACTIVE_LEVEL
    prompt "LED Active Level"
    default LED_ACTIVE_HIGH
    depends on ENABLE_LED

config LED_ACTIVE_HIGH
    bool "Active High"
config LED_ACTIVE_LOW
    bool "Active Low"
endchoice

config LED_PIN
    int "LED Pin"
    default 25
    depends on ENABLE_LED
endmenu

menu "Key Configuration"
config POWER_KEY_HOLD_TIME
    int "Power Key Hold Time (ms)"
    default 50

choice POWER_KEY_ACTIVE_LEVEL
    prompt "Power Key Active Level"
    default POWER_KEY_ACTIVE_LOW

config POWER_KEY_ACTIVE_HIGH
    bool "Active High"
config POWER_KEY_ACTIVE_LOW
    bool "Active Low"
endchoice

config POWER_KEY_PIN
    int "Power Key Pin"
    default 0
endmenu

menu "Relay Configuration"
choice RELAY_PIN_ACTIVE_LEVEL
    prompt "Relay Pin Active Level"
    default RELAY_PIN_ACTIVE_HIGH

config RELAY_PIN_ACTIVE_HIGH
    bool "Active High"
config RELAY_PIN_ACTIVE_LOW
    bool "Active Low"
endchoice

config RELAY_PIN
    int "Relay Pin"
    default 26
endmenu

menu "Audio Configuration"
config ENABLE_AUDIO_PROMPT
    bool "Enable Audio Prompt"
    default y

choice AUDIO_OUTPUT
    prompt "Audio Output"
    default AUDIO_OUTPUT_I2S1
    depends on ENABLE_AUDIO_PROMPT

    config AUDIO_OUTPUT_I2S0
        bool "I2S-0"
    config AUDIO_OUTPUT_I2S1
        bool "I2S-1"
endchoice

config AUDIO_OUTPUT_I2S_NUM
    int
    default 0 if AUDIO_OUTPUT_I2S0
    default 1 if AUDIO_OUTPUT_I2S1
    default 2 if !ENABLE_AUDIO_PROMPT

config I2S_BCLK_PIN
    int "I2S BCLK Pin"
    default 22
    depends on ENABLE_AUDIO_PROMPT

config I2S_LRCK_PIN
    int "I2S LRCK Pin"
    default 21
    depends on ENABLE_AUDIO_PROMPT

config I2S_DOUT_PIN
    int "I2S DOUT Pin"
    default 19
    depends on ENABLE_AUDIO_PROMPT
endmenu

endmenu
```
